## devices/esp32/main/Kconfig.projbuild
```kconfig
menu "Voice Satellite"

choice VS_INPUT_PROFILE
    prompt "Input profile"
    default VS_PROFILE_PTT
    config VS_PROFILE_PTT
        bool "Push to talk"
    config VS_PROFILE_WAKENET
        bool "WakeNet local wake word with Relay endpointing"
endchoice

config VS_WIFI_SSID
    string "Wi-Fi SSID fallback"
    default ""

config VS_WIFI_PASSWORD
    string "Wi-Fi password fallback"
    default ""

config VS_RELAY_URL
    string "Relay Device Link URL fallback"
    default "wss://relay.example.invalid/v1/device"

config VS_DEVICE_TOKEN
    string "Device bearer token fallback"
    default ""

config VS_ALLOW_INSECURE_WS
    bool "Allow ws:// for local development"
    default n

config VS_PHYSICAL_APPROVAL
    bool "Use BOOT key for physical approval"
    default y

config VS_OUTPUT_VOLUME
    int "Speaker output volume"
    range 0 100
    default 70

config VS_MAX_CAPTURE_MS
    int "Maximum capture duration in milliseconds"
    range 1000 30000
    default 15000

endmenu
```

## devices/esp32/profiles/wakenet/sdkconfig.defaults
```kconfig
CONFIG_VS_PROFILE_WAKENET=y
CONFIG_VS_PROFILE_PTT=n
CONFIG_SR_WN_WN9_NIHAOXIAOZHI_TTS=y
```

## devices/esp32/sdkconfig.defaults
```kconfig
CONFIG_IDF_TARGET="esp32s3"
CONFIG_ESPTOOLPY_FLASHSIZE_16MB=y
CONFIG_PARTITION_TABLE_CUSTOM=y
CONFIG_PARTITION_TABLE_CUSTOM_FILENAME="partitions.csv"
CONFIG_ESP_DEFAULT_CPU_FREQ_MHZ_240=y
CONFIG_SPIRAM=y
CONFIG_SPIRAM_MODE_OCT=y
CONFIG_SPIRAM_SPEED_80M=y
CONFIG_SPIRAM_MALLOC_ALWAYSINTERNAL=2048
CONFIG_SPIRAM_MALLOC_RESERVE_INTERNAL=65536
CONFIG_MBEDTLS_EXTERNAL_MEM_ALLOC=y
CONFIG_MBEDTLS_CERTIFICATE_BUNDLE=y
CONFIG_ESP_WIFI_STATIC_RX_BUFFER_NUM=10
CONFIG_ESP_WIFI_DYNAMIC_RX_BUFFER_NUM=32
CONFIG_COMPILER_OPTIMIZATION_PERF=y
CONFIG_LOG_DEFAULT_LEVEL_INFO=y
CONFIG_VS_PROFILE_PTT=y
CONFIG_LV_FONT_MONTSERRAT_16=y
CONFIG_LV_FONT_FMT_TXT_LARGE=y
```
